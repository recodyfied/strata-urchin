#define ZMK_MOUSE_DEFAULT_MOVE_VAL 1500  // 600
#define ZMK_MOUSE_DEFAULT_SCRL_VAL 20    // 10

#include <dt-bindings/zmk/mouse.h>

// Config from @caksoylar, defaults in comments
&mmv {
  acceleration-exponent = <2>;      // 1
  time-to-max-speed-ms = <300>;     // 300
  delay-ms = <0>;                   // 0
};

&msc {
  acceleration-exponent = <2>;      // 0
  time-to-max-speed-ms = <40>;      // 300
  delay-ms = <0>;                   // 0
};

#define MMOVE_U &mmv MOVE_UP
#define MMOVE_D &mmv MOVE_DOWN
#define MMOVE_L &mmv MOVE_LEFT
#define MMOVE_R &mmv MOVE_RIGHT
#define MSCRL_U &msc SCRL_UP
#define MSCRL_D &msc SCRL_DOWN
#define MSCRL_L &msc SCRL_LEFT
#define MSCRL_R &msc SCRL_RIGHT
#define MCLCK_L &mkp LCLK
#define MCLCK_R &mkp RCLK
#define MCLCK_M &mkp MCLK
#define MCLCK_4 &mkp MB4
#define MCLCK_5 &mkp MB5
